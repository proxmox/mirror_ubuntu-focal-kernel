## Documentation/devicetree/bindings/mfd/ahc1ec0.yaml
```yaml
# SPDX-License-Identifier: (GPL-2.0-only OR BSD-2-Clause)
%YAML 1.2
---
$id: http://devicetree.org/schemas/mfd/ahc1ec0.yaml#
$schema: http://devicetree.org/meta-schemas/core.yaml#

title: Advantech Embedded Controller (AHC1EC0)

maintainers:
  - Campion Kang <campion.kang@advantech.com.tw>

description: |
  AHC1EC0 is one of the embedded controllers used by Advantech to provide several
  functions such as watchdog, hwmon, brightness, etc. Advantech related applications
  can control the whole system via these functions.

properties:
  compatible:
    const: advantech,ahc1ec0

  advantech,sub-dev-nb:
    description:
      The number of sub-devices specified in the platform.
    $ref: /schemas/types.yaml#/definitions/uint32
    maxItems: 1

  advantech,sub-dev:
    description:
      A list of the sub-devices supported in the platform. Defines for the
      appropriate values can found in dt-bindings/mfd/ahc1ec0-dt.h.
    $ref: "/schemas/types.yaml#/definitions/uint32-array"
    minItems: 1
    maxItems: 6

  advantech,hwmon-profile:
    description:
      The number of sub-devices specified in the platform. Defines for the
      hwmon profiles can found in dt-bindings/mfd/ahc1ec0-dt.
    $ref: /schemas/types.yaml#/definitions/uint32
    maxItems: 1

required:
  - compatible
  - advantech,sub-dev-nb
  - advantech,sub-dev

if:
  properties:
    advantech,sub-dev:
      contains:
        const: 0x3
then:
  required:
    - advantech,hwmon-profile

additionalProperties: false

examples:
  - |
    #include <dt-bindings/mfd/ahc1ec0-dt.h>
    ahc1ec0 {
        compatible = "advantech,ahc1ec0";

        advantech,sub-dev-nb = <2>;
        advantech,sub-dev = <AHC1EC0_SUBDEV_HWMON
                             AHC1EC0_SUBDEV_WDT>;

        advantech,hwmon-profile = <AHC1EC0_HWMON_PRO_UNO2271G>;
    };
```
